## boards/shields/splitfire/Kconfig.defconfig
```kconfig
if SHIELD_SPLITFIRE_LEFT

config ZMK_SPLITFIRE_NAME
    default "Splitfire"

config ZMK_SPLIT_ROLE_CENTRAL
    default y
endif

if SHIELD_SPLITFIRE_LEFT  || SHIELD_SPLITFIRE_RIGHT
config ZMK_SPLIT
    default y
endif
```

## boards/shields/splitfire/Kconfig.shield
```kconfig
config SHIELD_SPLITFIRE_LEFT
    def_bool $(shields_list_contains,splitfire_left)
config SHIELD_SPLITFIRE_RIGHT
    def_bool $(shields_list_contains,splitfire_right)
```
